/*
 * Левая половина Keyball61 (без трекбола), периферийная часть:
 * подключается к донглу по Bluetooth.
 * Пины матрицы те же, что и у правой половины (в QMK-конфиге они общие).
 * Ключи левой половины идут в карте первыми, смещение не нужно.
 */

#include "keyball61.dtsi"
