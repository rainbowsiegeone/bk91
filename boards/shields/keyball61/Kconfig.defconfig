## boards/shields/keyball61/Kconfig.shield
```kconfig
# Keyball61 (ZMK)

config SHIELD_KEYBALL61_RIGHT
	def_bool $(shields_list_contains,keyball61_right)

config SHIELD_KEYBALL61_DONGLE
	def_bool $(shields_list_contains,keyball61_dongle)

config SHIELD_KEYBALL61_LEFT
	def_bool $(shields_list_contains,keyball61_left)
```

## config/west.yml
```yaml
manifest:
  remotes:
    - name: zmkfirmware
      url-base: https://github.com/zmkfirmware
    - name: finn-e
      url-base: https://github.com/finn-e
  projects:
    - name: zmk
      remote: zmkfirmware
      revision: main
      import: app/west.yml
    - name: zmk-driver-pmw3389
      remote: finn-e
      revision: main
  self:
    path: config
```
