/*
 * Keyball61, часть для половин клавиатуры (не для донгла):
 * дуплексная матрица, прочитанная как charlieplex.
 *
 * Порядок пинов в gpios (индексы 0..8):
 *   0..4 = ROW0..ROW4  (Pro Micro D4, D5, D6, D7, D8)
 *   5..8 = COL0..COL3  (Pro Micro A3, A2, A1, A0 = номера 21, 20, 19, 18)
 */

#include "keyball61_layout.dtsi"

/ {
    chosen {
        zmk,kscan = &kscan0;
    };

    kscan0: kscan {
        compatible = "zmk,kscan-gpio-charlieplex";
        /* interrupt-gpios не задан -> постоянный опрос */
        gpios
            = <&pro_micro 4  GPIO_ACTIVE_HIGH>   /* ROW0 */
            , <&pro_micro 5  GPIO_ACTIVE_HIGH>   /* ROW1 */
            , <&pro_micro 6  GPIO_ACTIVE_HIGH>   /* ROW2 */
            , <&pro_micro 7  GPIO_ACTIVE_HIGH>   /* ROW3 */
            , <&pro_micro 8  GPIO_ACTIVE_HIGH>   /* ROW4 */
            , <&pro_micro 21 GPIO_ACTIVE_HIGH>   /* COL0 (A3) */
            , <&pro_micro 20 GPIO_ACTIVE_HIGH>   /* COL1 (A2) */
            , <&pro_micro 19 GPIO_ACTIVE_HIGH>   /* COL2 (A1) */
            , <&pro_micro 18 GPIO_ACTIVE_HIGH>   /* COL3 (A0) */
            ;
    };
};
